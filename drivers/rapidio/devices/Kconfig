## drivers/rapidio/devices/Kconfig
```kconfig
# SPDX-License-Identifier: GPL-2.0-only
#
# RapidIO master port configuration
#

config RAPIDIO_TSI721
	tristate "IDT Tsi721 PCI Express SRIO Controller support"
	depends on RAPIDIO && PCIEPORTBUS
	default "n"
	help
	  Include support for IDT Tsi721 PCI Express Serial RapidIO controller.

config FSL_RIO
	tristate "Freescale Embedded SRIO Controller support"
	depends on RAPIDIO && PPC_E500
	default "n"
	help
	  Include support for RapidIO controller on Freescale embedded
	  processors (MPC8548, MPC8641, P-Series, T-Series, etc).
```

## drivers/staging/cryptodev/Kconfig
```kconfig
config CRYPTODEV
	tristate "BSD Compatible Crypto Device"
	default n
	---help---
	  Provides a /dev/crypto for userspace access to kernel crypto
	  routines to make use of hardware off-load and accelerators.

#Device configurations
if CRYPTODEV

#Enables async mode.
config CRYPTODEV_ENABLE_ASYNC
       bool "Enable ASYNC mode."
       default n
       ---help---
       Enables Async Block Cipher calls. Deprecared around kernel 4.6.
       Since version 1.6 the asynchronous mode has been disabled by default. 

#Enables debug mode.
config CRYPTODEV_DEBUG
       bool "Enable Debug  mode."
       default y
       ---help---
       Enables Async Block Cipher calls. Deprecared around kernel 4.6.

#Crypto algorithm kernel driver only.
config CRYPTODEV_CRYPTO_ALG_KERN_DRIVER_ONLY
       bool "Crypto kernel drivers only."
       default n
       ---help---
       All crypto done by kernel drivers. No offload.

#Enable 32 bit user space compatibility.
config CRYPTODEV_CONFIG_COMPAT
       bool "Enable 32 bit user space compatibility mode."
       default n
       ---help---
       Enable compatibility mode for 32 bit user space.

endif # CRYPTODEV
```

## drivers/staging/skmm-host/Kconfig
```kconfig
config FSL_C2X0_CRYPTO_DRV
        tristate "Freescale SKMM Host driver for C29x"
        default n
	select SOC_BUS
        ---help---
          Provides access to c293pcie
          routines to make use of hardware off-load and accelerators.

#Device configurations
if FSL_C2X0_CRYPTO_DRV

#Specifies type of EP
config FSL_C2X0_P4080_EP
       bool "P4080 SOC device."
       default n
       ---help---
       P4080 based SEC engine.

config FSL_C2X0_C293_EP
       bool "C293 PCIe card."
       default y
       ---help---
       Build for PCIe card.

#Controls the debug print level
config FSL_C2X0_DEBUG_PRINT
        bool "Controls the debug print level."
        default y

#Controls error printing.
config FSL_C2X0_ERROR_PRINT
        bool "Controls error printing."
        default y

#Controls info printing.
config FSL_C2X0_INFO_PRINT
        bool "Controls info printing."
        default y

#Enable HASH/SYMMETRIC offloading
config FSL_C2X0_HASH_OFFLOAD
       bool "Enable HASH offloading."
       default y

config FSL_C2X0_SYMMETRIC_OFFLOAD
       bool "Enable Symetric key offloading."
       default y

#Enable RNG offloading
config FSL_C2X0_RNG_OFFLOAD
       bool "Enable RNG offloading."
       default y

#Specifies whether host DMA support to be enabled /disabled in the driver
config FSL_C2X0_USE_HOST_DMA
       bool "Enable host DMA support in the driver."
       default n

#Specifies whether driver/firmware is running high performance mode
config FSL_C2X0_HIGH_PERF_MODE
       bool "Enable High Performance Mode."
       default y

#Specify building host-driver to support Virtualization
config FSL_C2X0_VIRTIO
       bool "Enable virtualization support."
       default y
       ---help---
       All offloading depends on Virtualization support.

# Specific no pkc support in module or kernel.
config FSL_C2X0_NO_PKC
	bool "No PKC support in driver or kernel."
        default n

#Specify whether build cryptoapi pkc-related into host driver on x86
config FSL_C2X0_EXTRA_PKC
       bool "Add PKC support in driver."
       default y

endif # FSL_C2X0_CRYPTO_DRV
```
